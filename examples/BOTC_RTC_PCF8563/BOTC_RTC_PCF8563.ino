/*
  BrgOfTheCyber_RTC - BOTC_RTC_Sys
  Демонстрация работы часов с модулем PCF8563.
  Репозиторий: https://github.com/BOTCLibs/BrgOfTheCyber_RTC

  Подключение PCF8563:
  ├─── VCC ────────────────> 5V
  ├─── GND ────────────────> GND  
  ├─── SDA ────────────────> A4
  └─── SCL ────────────────> A5
*/

#include <BrgOfTheCyber_RTC.h>                          // Подключаем библиотеку для работы с внешними RTC модулями.
BrgOfTheCyber_RTC rtc(RTC_PCF8563, 0x51);               // Инициализация объекта для модуля PCF8563 с адресом 0x51

void setup() {
  Serial.begin(9600);                                   // Инициализирует последовательное соединение и задаём скорость передачи данных.
  delay(1000);                                          // Задержка 1000ms (1s)
  
  Serial.println("Демонстрация работы модуля PCF8563:");
  
  if (!rtc.begin()) {                                   // Инициализация модуля PCF8563, если модуль не найден.
    Serial.println("Ошибка: PCF8563 не найден!");       // Вывод сообщения "Ошибка: PCF8563 не найден!".
    Serial.println("Адрес I2C: 0x51 (обычно)");         // 
    while(1);                                           // Бесконечный цикл при ошибке.
  }
  
  Serial.println("Модуль PCF8563 подключен!");          // Сообщение об успешном подключении.
  
  rtc.setDateTime(2025, 1, 1, 0, 0, 0);                 // Установите время один раз, затем закомментируйте.
}

void loop() {
  static uint32_t Timer = 0;                            // Объявление локальной переменной. (таймер-1)
  
  if (millis() - Timer >= 1000) {                       // Если отсчитанное время >= 1000 ms, тогда:
    Timer = millis();                                   // Сброс таймера-1.
    
    Serial.print("Дата и время: ");                     // Вывод сообщения "Дата и время"
    Serial.print(rtc.getDateTime());                    // Получаем и отправляем информацию о Дате и Времени. Пример: 01/01/2025 00:00:00
    
    Serial.print(" | Время с тиканием: ");              // Вывод сообщения " | Время с тиканием: "
    Serial.println(rtc.getTime(true));                  // Получаем и отправляем информацию Времени. Пример: 00:00 (00 00)
    
    static uint8_t Timer2 = 0;                          // Объявление локальной переменной. (таймер-2)
    if (++Timer2 >= 10) {                               // Каждые 10 секунд отправляем подробную информацию.
      Timer2 = 0;                                       // Сброс таймера-2.
      
      // Создаем кастомный формат вывода
      Serial.print("Кастомный формат: ");               // Вывод сообщения "Кастомный формат: "
      Serial.print(rtc.getDay());                       // Получаем и отправляем информацию "День". Пример: 1
      Serial.print(".");                                // Вывод точки как разделителя
      Serial.print(rtc.getMonth());                     // Получаем и отправляем информацию "Месяц". Пример: 1
      Serial.print(".");                                // Вывод точки как разделителя
      Serial.print(rtc.getYear());                      // Получаем и отправляем информацию "Год". Пример: 2025
      Serial.print(" ");                                // Вывод пробела
      Serial.print(rtc.getHour());                      // Получаем и отправляем информацию "Час". Пример: 0
      Serial.print(":");                                // Вывод двоеточия как разделителя
      Serial.print(rtc.getMinute());                    // Получаем и отправляем информацию "Минута". Пример: 0
      Serial.print(":");                                // Вывод двоеточия как разделителя
      Serial.print(rtc.getSecond());                    // Получаем и отправляем информацию "Секунда". Пример: 0

      Serial.print("Формат ДД/ММ: ");                   // Вывод сообщения "Формат ДД/ММ: "
      Serial.print(rtc.getToDay());                     // Получаем и отправляем информацию в формате День/Месяц. Пример: 01/01
      Serial.print(" | Формат ДД/ММ/ГГГГ: ");           // Вывод сообщения " | Формат ДД/ММ/ГГГГ: "
      Serial.println(rtc.getDate());                    // Получаем и отправляем информацию в формате День/Месяц/Год. Пример: 01/01/2025

      Serial.print(" | Проверка работы: ");             // Вывод сообщения " | Проверка работы: "
      if (rtc.isRunning()) {                            // Проверяем, работает ли модуль
        Serial.println("Модуль работает корректно");    // Сообщение о корректной работе
      } else {
        Serial.println("Ошибка модуля!");               // Сообщение об ошибке
      }
    }
  }
}