/*
  BrgOfTheCyber_RTC - BOTC_RTC_Sys
  Демонстрация работы часов с модулем DS3231.
  Репозиторий: https://github.com/BOTCLibs/BrgOfTheCyber_RTC
  
  Подключение DS3231:
  ├─── VCC ────────────────> 5V
  ├─── GND ────────────────> GND  
  ├─── SDA ────────────────> A4
  └─── SCL ────────────────> A5
*/

#include <BrgOfTheCyber_RTC.h>                          // Подключаем библиотеку для работы с внешними RTC модулями.
BrgOfTheCyber_RTC rtc(RTC_DS3231);                      // Инициализация объекта для модуля DS3231.

void setup() {
  Serial.begin(9600);                                   // Инициализирует последовательное соединение и задаём скорость передачи данных.
  delay(1000);                                          // Задержка 1000ms (1s)
  
  Serial.println("Демонстрация работы модуля DS3231:");
  
  if (!rtc.begin()) {                                   // Инициализация модуля DS3231, если модуль не найден.
    Serial.println("Ошибка: DS3231 не найден!");        // Вывод сообщения "Ошибка: DS3231 не найден!".
    while(1);                                           // Бесконечный цикл при ошибке.
  }
  
  Serial.println("Модуль DS3231 подключен!");           // Сообщение об успешном подключении.
  
  float temp = rtc.getTemperature();                    // Получаем температуру с модуля DS3231.
  if (temp > -100) {                                    // Если температура корректная.
    Serial.print("Температура DS3231: ");               // Вывод сообщения "Температура DS3231: "
    Serial.print(temp);                                 // Вывод значения температуры.
    Serial.println("°C");                               // Вывод единицы измерения "°C"
  }
  
  if (rtc.lostPower()) {                                // Проверяем, терял ли модуль питание.
    Serial.println("Внимание: DS3231 терял питание!");  // Вывод предупреждения о потере питания.
    Serial.println("Рекомендация: Настройте время.");   // Вывод рекомендации.
  }
  
  rtc.setDateTime(2025, 1, 1, 0, 0, 0);                 // Установите время один раз, затем закомментируйте.
}

void loop() {
  static uint32_t Timer = 0;                            // Объявление локальной переменной. (таймер-1)
  
  if (millis() - Timer >= 1000) {                       // Если отсчитанное время >= 1000 ms, тогда:
    Timer = millis();                                   // Сброс таймера-1.
    
    Serial.print("Дата и время: ");                     // Вывод сообщения "Дата и время"
    Serial.print(rtc.getDateTime());                    // Получаем и отправляем информацию о Дате и Времени. Пример: 01/01/2025 00:00:00
    
    Serial.print(" | Время с тиканием: ");              // Вывод сообщения " | Время с тиканием: "
    Serial.println(rtc.getTime(true));                  // Получаем и отправляем информацию Времени. Пример: 00:00 (00 00)
    
    static uint8_t Timer2 = 0;                          // Объявление локальной переменной. (таймер-2)
    if (++Timer2 >= 10) {                               // Каждые 10 секунд отправляем подробную информацию.
      Timer2 = 0;                                       // Сброс таймера-2.
      
      float currentTemp = rtc.getTemperature();         // Получаем текущую температуру.
      Serial.print("Температура: ");                    // Вывод сообщения "Температура: "
      Serial.print(currentTemp);                        // Вывод значения температуры.
      Serial.print("°C | ");                            // Вывод единицы измерения "°C | "
      
      Serial.print("Подробно: Год=");                   // Вывод сообщения "Подробно: Год="
      Serial.print(rtc.getYear());                      // Получаем и отправляем информацию "Год". Пример: 2025
      Serial.print(" Месяц=");                          // Вывод сообщения " Месяц="
      Serial.print(rtc.getMonth());                     // Получаем и отправляем информацию "Месяц". Пример: 1
      Serial.print(" День=");                           // Вывод сообщения " День="
      Serial.print(rtc.getDay());                       // Получаем и отправляем информацию "День". Пример: 1
      Serial.print(" Час=");                            // Вывод сообщения " Час="
      Serial.print(rtc.getHour());                      // Получаем и отправляем информацию "Час". Пример: 0
      Serial.print(" Минута=");                         // Вывод сообщения " Минута="
      Serial.print(rtc.getMinute());                    // Получаем и отправляем информацию "Минута". Пример: 0
      Serial.print(" Секунда=");                        // Вывод сообщения " Секунда="
      Serial.println(rtc.getSecond());                  // Получаем и отправляем информацию "Секунда". Пример: 0
    }
  }
}